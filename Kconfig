## Kconfig
```kconfig
DT_COMPAT_ZMK_BEHAVIOR_SCROLL_AXIS_LOCK := zmk,behavior-scroll-axis-lock
DT_COMPAT_ZMK_INPUT_PROCESSOR_SCROLL_AXIS_LOCK_MAPPER := zmk,input-processor-scroll-axis-lock-mapper
DT_COMPAT_ZMK_INPUT_PROCESSOR_AML_TEMP_LAYER := zmk,input-processor-aml-temp-layer

config ZMK_BEHAVIOR_SCROLL_AXIS_LOCK
    bool
    default $(dt_compat_enabled,$(DT_COMPAT_ZMK_BEHAVIOR_SCROLL_AXIS_LOCK))

config ZMK_INPUT_PROCESSOR_SCROLL_AXIS_LOCK_MAPPER
    bool
    default $(dt_compat_enabled,$(DT_COMPAT_ZMK_INPUT_PROCESSOR_SCROLL_AXIS_LOCK_MAPPER))

config ZMK_INPUT_PROCESSOR_AML_TEMP_LAYER
    bool
    default $(dt_compat_enabled,$(DT_COMPAT_ZMK_INPUT_PROCESSOR_AML_TEMP_LAYER))
```

## config/west.yml
```yaml
manifest:
  remotes:
    - name: karuta88
      url-base: https://github.com/karuta88
    - name: badjeff
      url-base: https://github.com/badjeff
    - name: caksoylar
      url-base: https://github.com/caksoylar
    - name: kot149
      url-base: https://github.com/kot149
  projects:
    - name: zmk
      remote: karuta88
      revision: v0.3
      import: app/west.yml
    - name: zmk-pmw3610-driver
      remote: badjeff
      revision: zmk-0.3
    - name: zmk-rgbled-widget
      remote: caksoylar
      revision: v0.3-branch
    - name: zmk-layout-shift
      remote: kot149
      revision: v1
  self:
    path: config
```

## dts/bindings/behaviors/zmk,behavior-lang-toggle.yaml
```yaml
description: Alternating language key behavior

compatible: "zmk,behavior-lang-toggle"

include: zero_param.yaml

properties:
  first-key:
    type: int
    required: true
  second-key:
    type: int
    required: true
```

## dts/bindings/behaviors/zmk,behavior-scroll-axis-lock.yaml
```yaml
description: Momentary scroll axis lock behavior

compatible: "zmk,behavior-scroll-axis-lock"

include: zero_param.yaml

properties:
  axis:
    type: int
    required: true
```

## dts/bindings/zmk,input-processor-aml-temp-layer.yaml
```yaml
description: Temporary pointer layer that rearms after the pointer has been idle

compatible: "zmk,input-processor-aml-temp-layer"

include: ip_two_param.yaml

properties:
  require-prior-idle-ms:
    type: int
    required: false
    default: 0
    description: Time after the last keystroke before the layer can activate

  rearm-after-pointer-idle-ms:
    type: int
    required: true
    description: Pointer idle time required after a keyboard exit before the layer can activate again

  rearm-positions:
    type: array
    required: false
    default: []
    description: Key positions that require pointer idle before the layer can activate again

  excluded-positions:
    type: array
    required: false
    default: []
    description: Key positions that do not deactivate the layer
```

## dts/bindings/zmk,input-processor-scroll-axis-lock-mapper.yaml
```yaml
description: Scroll mapper with a behavior-controlled axis lock

compatible: "zmk,input-processor-scroll-axis-lock-mapper"

include: ip_zero_param.yaml
```
