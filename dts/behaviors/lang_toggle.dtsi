#include <dt-bindings/zmk/keys.h>

/ {
    behaviors {
        lang_tog: lang_toggle {
            compatible = "zmk,behavior-lang-toggle";
            #binding-cells = <0>;
            first-key = <LANG1>;
            second-key = <LANG2>;
        };
    };
};
